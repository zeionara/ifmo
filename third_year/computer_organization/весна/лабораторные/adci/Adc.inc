
	
//Сигнальная функция для работы с Логическим анализатором (файл adc.inc)
SIGNAL void Signa(void) {   //Сигнальная функция
float x; 
char i;
while (1) {
    //__sin(x) -формирование аналоговой (float) величины  с учетом опорного (и максимального по умолчанию) напряжения  0xff ~5в 
 for(i=0;i<100;i++){  
 AIN0 =__sin(x)*2 + 2.0;  //масштабирование и смещение в положительной области на 2 вольта
     twatch (100);   //задержка для последовательного исполнения симулятором   программ  100*100  мкс
     x=x+0.062;
	 }
      }
}

Signa()    //запуск сигнальной функции  -
LA AIN0     // контроль аналогового сигнала на входе
LA PORT2  //чтение целой величины -результата преобразования через порт P3 из программы измерения. 
